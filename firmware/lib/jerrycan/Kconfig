## firmware/lib/jerrycan/Kconfig
```kconfig
menuconfig LIB_JERRYCAN
    bool "Enable the JerryCAN library"
    default n
    depends on DT_HAS_ST_STM32_FDCAN_ENABLED
    select CAN
    select CAN_FD_MODE
    select CAN_STM32_FDCAN
    depends on LIB_JERRYCAN_AUDIO_PRIORITY < 0
    depends on LIB_JERRYCAN_AUDIO_STACK_SIZE > 0
    help
      Enable the library that handles CAN communication for the the MouseGym system.

config LIB_JERRYCAN_LOG_LEVEL
  int "Log level (0-4)"
  default 3
  help
      Set the log level for the tone generator

menuconfig LIB_JERRYCAN_HEARTBEAT_LED_DURATION_MS
  int "Heartbeat LED duration"
  default 100
  depends on LIB_JERRYCAN
  help
    The duration for which the heartbeat LED remains on after the reception of a heartbeat message

menuconfig LIB_JERRYCAN_STATUS_TX_PERIOD_MS
    int "Status TX Period (effectively unused)"
    default 1000
    depends on LIB_JERRYCAN
    help
      The period at which the status message is transmitted in milliseconds.

menuconfig LIB_JERRYCAN_TEMPERATURE_TX_PERIOD_MS
    int "Temperature TX Period"
    default 100
    depends on LIB_JERRYCAN_TEMPERATURE_SENSOR
    help
      The period at which the temperature message is transmitted in milliseconds.

menuconfig LIB_JERRYCAN_PRESSURE_TX_PERIOD_MS
    int "Pressure TX Period"
    default 12
    depends on LIB_JERRYCAN
    help
      The period at which the pressure message is transmitted in milliseconds.

menuconfig LIB_JERRYCAN_GPIO_TX_PERIOD_MS
    int "GPIO TX Period"
    default 100
    depends on LIB_JERRYCAN
    help
      The period at which the GPIO message is transmitted in milliseconds.

menuconfig LIB_JERRYCAN_TONE_TX_PERIOD_MS
    int "Tone Generator TX Period"
    default 100
    depends on LIB_JERRYCAN
    help
      The period at which the tone generator message is transmitted in milliseconds.

menuconfig LIB_JERRYCAN_ANALOG_OUT_TX_PERIOD_MS
    int "Analog Out TX Period"
    default 1000
    depends on LIB_JERRYCAN
    help
      The period at which the analog output message is transmitted in milliseconds.

menuconfig LIB_JERRYCAN_LOAD_CELL_TX_PERIOD_MS
    int "Load Cell TX Period"
    default 12
    depends on LIB_JERRYCAN
    help
      The period at which the load cell message is transmitted in milliseconds.

menuconfig LIB_JERRYCAN_DOOR_SENSOR_TX_PERIOD_MS
    int "Door Sensor TX Period"
    default 100
    depends on LIB_JERRYCAN
    help
      The period at which the door sensor message is transmitted in milliseconds.

menuconfig LIB_JERRYCAN_RGB_LED_STATUS_PERIOD_MS
    int "RGB LED TX Period"
    default 100
    depends on LIB_JERRYCAN
    help
      The period at which the RGB LED message is transmitted in milliseconds.

menuconfig LIB_JERRYCAN_TEMPERATURE_SENSOR
  bool "Enable Temperature Sensor"
  default y
  depends on LIB_JERRYCAN
  depends on DT_HAS_SENSIRION_SHT3XD_ENABLED
  select SHT3XD
  help
    Enable the JerryCAN Temperature Sensor module


menuconfig LIB_JERRYCAN_DOOR_SENSOR
    bool "Enable Door Sensors"
    default n
    select CONFIG_INPUT
    select CONFIG_INPUT_GPIO_KEYS
    select EVENTS
    help
      Enable the Door Sensors functionality on the pellet module

menuconfig LIB_JERRYCAN_RGB_LED
    bool "Enable RGB LED"
    default n
    select PWM
    select LED
    select LED_PWM
    help
      Enable the RGB LED functionality on the pellet module

menuconfig LIB_JERRYCAN_STEPPER_STATUS_TX_PERIOD_MS
    int "Stepper Status TX Period"
    default 100
    depends on LIB_JERRYCAN
    depends on DT_HAS_LL_STEPPER_ENABLED
    help
      The period at which each Stepper Status message is transmitted in milliseconds.

menuconfig LIB_JERRYCAN_SERVO_STATUS_TX_PERIOD_MS
    int "Servo Status TX Period"
    default 100
    depends on LIB_JERRYCAN
    depends on DT_HAS_LL_SERVO_ENABLED
    help
      The period at which each Servo Status message is transmitted in milliseconds.

menuconfig LIB_JERRYCAN_SHELL
    bool "Enable the shell for the JerryCAN library"
    default n
    depends on LIB_JERRYCAN
    depends on SHELL
    depends on CAN
    help
      Enable the shell for the JerryCAN library

menuconfig LIB_JERRYCAN_INIT_PRIORITY
    int "Initialization Priority"
    default 91
    depends on LIB_JERRYCAN
    help
      The initialization priority of the JerryCAN library.

config LIB_JERRYCAN_AUDIO_PRIORITY
   int "Initialization Priority for CANbus modules"
    default -1 if !CONFIG_DT_HAS_LL_MICROPHONE_ENABLED
    default 0
    range -16 0
    help
      The initialization priority of the JerryCAN library.

config LIB_JERRYCAN_AUDIO_STACK_SIZE
  int "Audio thread stack size"
  default 1 if !CONFIG_DT_HAS_LL_MICROPHONE_ENABLED
  default -1
```

## firmware/lib/motor_motion/Kconfig
```kconfig
menuconfig LIB_MOTOR_MOTION
    bool "Enable the motor motion mathematics library"
    default n
    depends on FPU
    select SETTINGS
    select LL_SERVO if DT_HAS_LL_SERVO_ENABLED
    select LL_STEPPER if DT_HAS_LL_STEPPER_ENABLED
    depends on LIB_MOTOR_MOTION_WORK_QUEUE_PRIORITY < 0
    depends on LIB_MOTOR_MOTOIN_SETTINGS_WORK_QUEUE_PRIORITY > 90
    depends on LIB_MOTOR_MOTION_WORK_QUEUE_STACK_SIZE > 0
    depends on LIB_MOTOR_MOTION_SETTINGS_WORK_QUEUE_STACK_SIZE > 0
    help
      Enable the library that calculates motor motion based on sinusoidal motion profiles.

menuconfig LIB_MOTOR_MOTION_LOG_LEVEL
    int "Log level for the motor motion mathematics library"
    default 4
    depends on LIB_MOTOR_MOTION
    help
      Set the log level for the motor motion math library.

menuconfig LIB_MOTOR_MOTION_SHELL
    bool "Enable the shell for the motor motion mathematics library"
    default n
    depends on LIB_MOTOR_MOTION
    help
      Enable the shell for the motor motion math library

config LIB_MOTOR_MOTION_DEFER_STEPPER_FIXED_POSITION
    bool "Ignore the stored stepper fixed position at boot"
    default y
    depends on LIB_MOTOR_MOTION && DT_HAS_LL_STEPPER_ENABLED
    help
      Load the persisted fixed X/Y/Z position but do not apply it, so each stepper reports and moves to 0
      until the host sets a fixed position. The host application was written against the pellet module
      losing this value across a reboot, which it did until the storage partition overlap of issue #7 was
      fixed. The record is still read and still written, so setting this to n gives the restored-position
      behaviour with no other change.

config LIB_MOTOR_MOTION_WORK_QUEUE_PRIORITY
  int "Thread priority for the motor motion work queue"
  default 0
  range -16 0

config LIB_MOTOR_MOTION_SETTINGS_WORK_QUEUE_PRIORITY
  int "Thread priority for background settings saves"
  default 89
  range 89 99

config LIB_MOTOR_MOTION_WORK_QUEUE_STACK_SIZE
  int "Work queue thread stack size"
  default 0

config LIB_MOTOR_MOTION_SETTINGS_WORK_QUEUE_STACK_SIZE
  int "Settings work queue thread stack size"
  default 0
```
